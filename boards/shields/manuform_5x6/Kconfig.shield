## boards/shields/manuform_5x6/Kconfig.shield
```kconfig
config SHIELD_MANUFORM_5X6_LEFT
    def_bool $(shields_list_contains,manuform_5x6_left)
  
config SHIELD_MANUFORM_5X6_RIGHT
    def_bool $(shields_list_contains,manuform_5x6_right)
  
```
